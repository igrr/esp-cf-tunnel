## Kconfig
```kconfig
menu "Cloudflare Tunnel (esp-cf-tunnel)"

    config CF_TUNNEL_TASK_STACK_SIZE
        int "Tunnel task stack size"
        default 8192
        help
            Stack of the task started by cft_tunnel_start(). Request handlers
            run in this task, so add what they need.

    config CF_TUNNEL_TASK_PRIORITY
        int "Tunnel task priority"
        default 5

    config CF_TUNNEL_MIN_FREE_HEAP
        int "Minimum free heap for new requests"
        default 32768
        help
            While less heap than this is free, new requests are answered with
            503 instead of being served, so that the connections to the edge
            and the requests in progress keep working. 0 disables the check.

endmenu
```

## examples/tunnel_ethernet/main/Kconfig.projbuild
```kconfig
menu "Tunnel example"

    config EXAMPLE_USE_INGRESS_RULES
        bool "Route requests by the tunnel's public hostnames"
        default y
        help
            Public hostnames whose service is on localhost (e.g. http://localhost:80)
            are served by this example; others, e.g. http://192.168.1.10:8080 or
            ssh://192.168.1.10:22, are proxied to that host.

    config EXAMPLE_STREAM_WINDOW_KB
        int "HTTP/2 receive window per stream (KiB)"
        default 128
        range 64 1024
        help
            How much request body the edge sends ahead (cft_tunnel_config_t.stream_window).
            Larger is faster for uploads; a stream whose receiver is slow, e.g. a proxied
            upload to a slow host, can hold up to this much in RAM.

    config EXAMPLE_PROXY_BUFFER_KB
        int "Buffer per proxied request and direction (KiB)"
        default 16
        range 4 256
        help
            cft_tunnel_config_t.proxy_buffer_size. Larger is a little faster for
            proxied downloads.

    config EXAMPLE_DEBUG_TUNNEL
        bool "Debug logging for the tunnel connection (needs LOG_MAXIMUM_LEVEL_DEBUG)"
        default n

    config EXAMPLE_ETH_MDC_GPIO
        int "SMI MDC GPIO"
        default 31 if IDF_TARGET_ESP32P4
        default 23

    config EXAMPLE_ETH_MDIO_GPIO
        int "SMI MDIO GPIO"
        default 52 if IDF_TARGET_ESP32P4
        default 18

    config EXAMPLE_ETH_PHY_RST_GPIO
        int "PHY reset GPIO (-1 if not connected)"
        default 51 if IDF_TARGET_ESP32P4
        default 5

    config EXAMPLE_ETH_PHY_ADDR
        int "PHY address (-1 to detect)"
        default -1

endmenu
```

## test_apps/device/main/Kconfig.projbuild
```kconfig
menu "Device test app"

    config TEST_NUM_CONNECTIONS
        int "Tunnel connections"
        range 1 4
        default 2

    config TEST_MAX_STREAMS
        int "Concurrent streams per connection"
        default 24

    config TEST_STREAM_WINDOW_KB
        int "HTTP/2 receive window per stream (KiB)"
        default 64
        help
            Data held for slow consumers is bounded by about this plus 64 KiB per
            connection; with two connections, 256 KiB at 64.

    config TEST_POSTER_THREADS
        int "Threads posting work to the tunnel"
        default 1

    config TEST_ETH_MDC_GPIO
        int "SMI MDC GPIO"
        default 31 if IDF_TARGET_ESP32P4
        default 23

    config TEST_ETH_MDIO_GPIO
        int "SMI MDIO GPIO"
        default 52 if IDF_TARGET_ESP32P4
        default 18

    config TEST_ETH_PHY_RST_GPIO
        int "PHY reset GPIO (-1 if not connected)"
        default 51 if IDF_TARGET_ESP32P4
        default 5

    config TEST_ETH_PHY_ADDR
        int "PHY address (-1 to detect)"
        default -1

endmenu
```
